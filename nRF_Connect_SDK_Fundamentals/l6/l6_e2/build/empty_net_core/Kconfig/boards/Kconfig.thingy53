## nRF_Connect_SDK_Fundamentals/l6/l6_e2/build/empty_net_core/Kconfig/boards/Kconfig.thingy53
```kconfig
# Load board Kconfig descriptions.
osource "/opt/nordic/ncs/v3.1.0/zephyr/boards/nordic/thingy53/Kconfig.thingy53"
```
